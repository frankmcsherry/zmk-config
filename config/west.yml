## config/west.yml
```yaml
manifest:
  remotes:
    - name: davidphilipbarr
      url-base: https://github.com/davidphilipbarr
  projects:
    - name: zmk
      remote: davidphilipbarr
      revision: cradio-v2
      import: app/west.yml
  self:
    path: config
```
